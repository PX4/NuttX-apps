## Kconfig
```kconfig
#
# For a description of the syntax of this configuration file,
# see the file kconfig-language.txt in the NuttX tools repository.
#

source "$APPSDIR/builtin/Kconfig"
source "$APPSDIR/canutils/Kconfig"
source "$APPSDIR/examples/Kconfig"
source "$APPSDIR/fsutils/Kconfig"
source "$APPSDIR/gpsutils/Kconfig"
source "$APPSDIR/graphics/Kconfig"
source "$APPSDIR/interpreters/Kconfig"
source "$APPSDIR/modbus/Kconfig"
source "$APPSDIR/netutils/Kconfig"
source "$APPSDIR/nshlib/Kconfig"
source "$APPSDIR/platform/Kconfig"
source "$APPSDIR/system/Kconfig"
source "$APPSDIR/testing/Kconfig"
source "$APPSDIR/wireless/Kconfig"
```

## canutils/Kconfig
```kconfig
#
# For a description of the syntax of this configuration file,
# see the file kconfig-language.txt in the NuttX tools repository.
#

menu "CAN Utilities"
source "$APPSDIR/canutils/canlib/Kconfig"
source "$APPSDIR/canutils/libcanard/Kconfig"
source "$APPSDIR/canutils/libobd2/Kconfig"
endmenu # CAN Utilities
```

## canutils/candump/Kconfig
```kconfig
#
# For a description of the syntax of this configuration file,
# see the file kconfig-language.txt in the NuttX tools repository.
#

config CANUTILS_CANDUMP
	tristate "SocketCAN candump tool"
	default n
	depends on NET_CAN
	---help---
		Enable the SocketCAN candump tool

if CANUTILS_CANDUMP
endif
```

## canutils/cansend/Kconfig
```kconfig
#
# For a description of the syntax of this configuration file,
# see the file kconfig-language.txt in the NuttX tools repository.
#

config CANUTILS_CANSEND
	tristate "SocketCAN cansend tool"
	default n
	depends on NET_CAN
	---help---
		Enable the SocketCAN cansend tool

if CANUTILS_CANSEND
endif
```

## examples/Kconfig
```kconfig
#
# For a description of the syntax of this configuration file,
# see the file kconfig-language.txt in the NuttX tools repository.
#

menu "Examples"
source "$APPSDIR/examples/adc/Kconfig"
source "$APPSDIR/examples/adxl372_test/Kconfig"
source "$APPSDIR/examples/ajoystick/Kconfig"
source "$APPSDIR/examples/alarm/Kconfig"
source "$APPSDIR/examples/apa102/Kconfig"
source "$APPSDIR/examples/apds9960/Kconfig"
source "$APPSDIR/examples/bastest/Kconfig"
source "$APPSDIR/examples/battery/Kconfig"
source "$APPSDIR/examples/bmp180/Kconfig"
source "$APPSDIR/examples/bridge/Kconfig"
source "$APPSDIR/examples/buttons/Kconfig"
source "$APPSDIR/examples/calib_udelay/Kconfig"
source "$APPSDIR/examples/can/Kconfig"
source "$APPSDIR/examples/canard/Kconfig"
source "$APPSDIR/examples/cctype/Kconfig"
source "$APPSDIR/examples/chat/Kconfig"
source "$APPSDIR/examples/configdata/Kconfig"
source "$APPSDIR/examples/cpuhog/Kconfig"
source "$APPSDIR/examples/cromfs/Kconfig"
source "$APPSDIR/examples/dac/Kconfig"
source "$APPSDIR/examples/dhcpd/Kconfig"
source "$APPSDIR/examples/dhtxx/Kconfig"
source "$APPSDIR/examples/discover/Kconfig"
source "$APPSDIR/examples/djoystick/Kconfig"
source "$APPSDIR/examples/dsptest/Kconfig"
source "$APPSDIR/examples/elf/Kconfig"
source "$APPSDIR/examples/fb/Kconfig"
source "$APPSDIR/examples/fboverlay/Kconfig"
source "$APPSDIR/examples/flash_test/Kconfig"
source "$APPSDIR/examples/flowc/Kconfig"
source "$APPSDIR/examples/ft80x/Kconfig"
source "$APPSDIR/examples/ftpc/Kconfig"
source "$APPSDIR/examples/ftpd/Kconfig"
source "$APPSDIR/examples/gpio/Kconfig"
source "$APPSDIR/examples/gps/Kconfig"
source "$APPSDIR/examples/hello/Kconfig"
source "$APPSDIR/examples/helloxx/Kconfig"
source "$APPSDIR/examples/hidkbd/Kconfig"
source "$APPSDIR/examples/i2schar/Kconfig"
source "$APPSDIR/examples/i2sloop/Kconfig"
source "$APPSDIR/examples/igmp/Kconfig"
source "$APPSDIR/examples/ina219/Kconfig"
source "$APPSDIR/examples/ina226/Kconfig"
source "$APPSDIR/examples/ipforward/Kconfig"
source "$APPSDIR/examples/json/Kconfig"
source "$APPSDIR/examples/leds/Kconfig"
source "$APPSDIR/examples/lis3dsh_reader/Kconfig"
source "$APPSDIR/examples/lsm330spi_test/Kconfig"
source "$APPSDIR/examples/lvgldemo/Kconfig"
source "$APPSDIR/examples/max31855/Kconfig"
source "$APPSDIR/examples/media/Kconfig"
source "$APPSDIR/examples/mld/Kconfig"
source "$APPSDIR/examples/mlx90614/Kconfig"
source "$APPSDIR/examples/mm/Kconfig"
source "$APPSDIR/examples/modbus/Kconfig"
source "$APPSDIR/examples/module/Kconfig"
source "$APPSDIR/examples/mount/Kconfig"
source "$APPSDIR/examples/mtdpart/Kconfig"
source "$APPSDIR/examples/mtdrwb/Kconfig"
source "$APPSDIR/examples/netloop/Kconfig"
source "$APPSDIR/examples/netpkt/Kconfig"
source "$APPSDIR/examples/nettest/Kconfig"
source "$APPSDIR/examples/nrf24l01_term/Kconfig"
source "$APPSDIR/examples/null/Kconfig"
source "$APPSDIR/examples/nunchuck/Kconfig"
source "$APPSDIR/examples/nx/Kconfig"
source "$APPSDIR/examples/nxdemo/Kconfig"
source "$APPSDIR/examples/nxflat/Kconfig"
source "$APPSDIR/examples/nxhello/Kconfig"
source "$APPSDIR/examples/nximage/Kconfig"
source "$APPSDIR/examples/nxlines/Kconfig"
source "$APPSDIR/examples/nxterm/Kconfig"
source "$APPSDIR/examples/nxtext/Kconfig"
source "$APPSDIR/examples/obd2/Kconfig"
source "$APPSDIR/examples/oneshot/Kconfig"
source "$APPSDIR/examples/pashello/Kconfig"
source "$APPSDIR/examples/pca9635/Kconfig"
source "$APPSDIR/examples/pdcurses/Kconfig"
source "$APPSDIR/examples/pf_ieee802154/Kconfig"
source "$APPSDIR/examples/pipe/Kconfig"
source "$APPSDIR/examples/poll/Kconfig"
source "$APPSDIR/examples/popen/Kconfig"
source "$APPSDIR/examples/posix_spawn/Kconfig"
source "$APPSDIR/examples/powerled/Kconfig"
source "$APPSDIR/examples/powermonitor/Kconfig"
source "$APPSDIR/examples/pppd/Kconfig"
source "$APPSDIR/examples/pty_test/Kconfig"
source "$APPSDIR/examples/pwm/Kconfig"
source "$APPSDIR/examples/qencoder/Kconfig"
source "$APPSDIR/examples/random/Kconfig"
source "$APPSDIR/examples/relays/Kconfig"
source "$APPSDIR/examples/rfid_readuid/Kconfig"
source "$APPSDIR/examples/rgbled/Kconfig"
source "$APPSDIR/examples/romfs/Kconfig"
source "$APPSDIR/examples/sendmail/Kconfig"
source "$APPSDIR/examples/serialblaster/Kconfig"
source "$APPSDIR/examples/serialrx/Kconfig"
source "$APPSDIR/examples/serloop/Kconfig"
source "$APPSDIR/examples/slcd/Kconfig"
source "$APPSDIR/examples/smps/Kconfig"
source "$APPSDIR/examples/sotest/Kconfig"
source "$APPSDIR/examples/stat/Kconfig"
source "$APPSDIR/examples/system/Kconfig"
source "$APPSDIR/examples/tcpblaster/Kconfig"
source "$APPSDIR/examples/tcpecho/Kconfig"
source "$APPSDIR/examples/telnetd/Kconfig"
source "$APPSDIR/examples/thttpd/Kconfig"
source "$APPSDIR/examples/tiff/Kconfig"
source "$APPSDIR/examples/timer/Kconfig"
source "$APPSDIR/examples/touchscreen/Kconfig"
source "$APPSDIR/examples/udgram/Kconfig"
source "$APPSDIR/examples/udp/Kconfig"
source "$APPSDIR/examples/udpblaster/Kconfig"
source "$APPSDIR/examples/unionfs/Kconfig"
source "$APPSDIR/examples/usbserial/Kconfig"
source "$APPSDIR/examples/userfs/Kconfig"
source "$APPSDIR/examples/usrsocktest/Kconfig"
source "$APPSDIR/examples/ustream/Kconfig"
source "$APPSDIR/examples/veml6070/Kconfig"
source "$APPSDIR/examples/watchdog/Kconfig"
source "$APPSDIR/examples/webserver/Kconfig"
source "$APPSDIR/examples/wget/Kconfig"
source "$APPSDIR/examples/wgetjson/Kconfig"
source "$APPSDIR/examples/xbc_test/Kconfig"
source "$APPSDIR/examples/xmlrpc/Kconfig"
source "$APPSDIR/examples/zerocross/Kconfig"
endmenu # Examples
```

## graphics/Kconfig
```kconfig
#
# For a description of the syntax of this configuration file,
# see the file kconfig-language.txt in the NuttX tools repository.
#

menu "Graphics Support"
source "$APPSDIR/graphics/NxWidgets/Kconfig"
source "$APPSDIR/graphics/ft80x/Kconfig"
source "$APPSDIR/graphics/littlevgl/Kconfig"
source "$APPSDIR/graphics/pdcurs34/Kconfig"
source "$APPSDIR/graphics/screenshot/Kconfig"
source "$APPSDIR/graphics/tiff/Kconfig"
source "$APPSDIR/graphics/traveler/Kconfig"
endmenu # Graphics Support
```

## graphics/NxWidgets/Kconfig
```kconfig
#
# For a description of the syntax of this configuration file,
# see the file kconfig-language.txt in the NuttX tools repository.
#

menu "NxWidgets/NxWM"
source "$APPSDIR/graphics/NxWidgets/UnitTests/Kconfig"
source "$APPSDIR/graphics/NxWidgets/nxwidgets/Kconfig"
source "$APPSDIR/graphics/NxWidgets/nxwm/Kconfig"
endmenu # NxWidgets/NxWM
```

## interpreters/Kconfig
```kconfig
#
# For a description of the syntax of this configuration file,
# see the file kconfig-language.txt in the NuttX tools repository.
#

menu "Interpreters"
source "$APPSDIR/interpreters/bas/Kconfig"
source "$APPSDIR/interpreters/ficl/Kconfig"
source "$APPSDIR/interpreters/minibasic/Kconfig"
source "$APPSDIR/interpreters/pcode/Kconfig"
endmenu # Interpreters
```

## system/Kconfig
```kconfig
#
# For a description of the syntax of this configuration file,
# see the file kconfig-language.txt in the NuttX tools repository.
#

menu "System Libraries and NSH Add-Ons"
source "$APPSDIR/system/cdcacm/Kconfig"
source "$APPSDIR/system/cfgdata/Kconfig"
source "$APPSDIR/system/cle/Kconfig"
source "$APPSDIR/system/composite/Kconfig"
source "$APPSDIR/system/critmon/Kconfig"
source "$APPSDIR/system/cu/Kconfig"
source "$APPSDIR/system/dhcpc/Kconfig"
source "$APPSDIR/system/embedlog/Kconfig"
source "$APPSDIR/system/flash_eraseall/Kconfig"
source "$APPSDIR/system/hex2bin/Kconfig"
source "$APPSDIR/system/hexed/Kconfig"
source "$APPSDIR/system/i2c/Kconfig"
source "$APPSDIR/system/lm75/Kconfig"
source "$APPSDIR/system/lzf/Kconfig"
source "$APPSDIR/system/mdio/Kconfig"
source "$APPSDIR/system/netdb/Kconfig"
source "$APPSDIR/system/nsh/Kconfig"
source "$APPSDIR/system/ntpc/Kconfig"
source "$APPSDIR/system/nxplayer/Kconfig"
source "$APPSDIR/system/nxrecorder/Kconfig"
source "$APPSDIR/system/ping/Kconfig"
source "$APPSDIR/system/ping6/Kconfig"
source "$APPSDIR/system/popen/Kconfig"
source "$APPSDIR/system/prun/Kconfig"
source "$APPSDIR/system/ramtest/Kconfig"
source "$APPSDIR/system/readline/Kconfig"
source "$APPSDIR/system/sched_note/Kconfig"
source "$APPSDIR/system/setlogmask/Kconfig"
source "$APPSDIR/system/stackmonitor/Kconfig"
source "$APPSDIR/system/sudoku/Kconfig"
source "$APPSDIR/system/symtab/Kconfig"
source "$APPSDIR/system/system/Kconfig"
source "$APPSDIR/system/taskset/Kconfig"
source "$APPSDIR/system/tee/Kconfig"
source "$APPSDIR/system/telnet/Kconfig"
source "$APPSDIR/system/termcurses/Kconfig"
source "$APPSDIR/system/ubloxmodem/Kconfig"
source "$APPSDIR/system/usbmsc/Kconfig"
source "$APPSDIR/system/vi/Kconfig"
source "$APPSDIR/system/zmodem/Kconfig"
endmenu # System Libraries and NSH Add-Ons
```

## wireless/Kconfig
```kconfig
#
# For a description of the syntax of this configuration file,
# see the file kconfig-language.txt in the NuttX tools repository.
#

menu "Wireless Libraries and NSH Add-Ons"
source "$APPSDIR/wireless/bluetooth/Kconfig"
source "$APPSDIR/wireless/ieee802154/Kconfig"
source "$APPSDIR/wireless/iwpan/Kconfig"
source "$APPSDIR/wireless/wapi/Kconfig"
endmenu # Wireless Libraries and NSH Add-Ons
```
